## config/boards/shields/dm/Kconfig.defconfig
```kconfig
if SHIELD_DM_LEFT

config ZMK_KEYBOARD_NAME
	default "Dactyl Manuform"

config ZMK_SPLIT_BLE_ROLE_CENTRAL
	default y
	
endif

if SHIELD_DM_LEFT || SHIELD_DM_RIGHT

config ZMK_SPLIT
	default y

endif
```

## config/boards/shields/dm/Kconfig.shield
```kconfig
config SHIELD_DM_LEFT
	def_bool $(shields_list_contains,dm_left)
	
config SHIELD_DM_RIGHT
	def_bool $(shields_list_contains,dm_right)
```
