// dm_left.overlay

#include "dm.dtsi"

&kscan0 {
	col-gpios
		= <&pro_micro 19 GPIO_ACTIVE_HIGH> // col1 in schematic
		, <&pro_micro 18 GPIO_ACTIVE_HIGH> // col2 in schematic
		, <&pro_micro 15 GPIO_ACTIVE_HIGH> // col3 in schematic
		, <&pro_micro 14 GPIO_ACTIVE_HIGH> // col4 in schematic
		, <&pro_micro 16 GPIO_ACTIVE_HIGH> // col5 in schematic
		, <&pro_micro 10 GPIO_ACTIVE_HIGH> // col6 in schematic
		;
};
		