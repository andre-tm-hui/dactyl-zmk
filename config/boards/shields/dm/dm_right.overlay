// dm_right.overlay

#include "dm.dtsi"

&default_transform {
	col-offset = <6>;
};

&kscan0 {
	col-gpios
		= <&pro_micro 10 GPIO_ACTIVE_HIGH> // col6 in schematic
		, <&pro_micro 16 GPIO_ACTIVE_HIGH> // col7 in schematic
		, <&pro_micro 14 GPIO_ACTIVE_HIGH> // col8 in schematic
		, <&pro_micro 15 GPIO_ACTIVE_HIGH> // col9 in schematic
		, <&pro_micro 18 GPIO_ACTIVE_HIGH> // col10 in schematic
		, <&pro_micro 19 GPIO_ACTIVE_HIGH> // col11 in schematic
		;
};